## configs/dm365leopardboard_defconfig
```kconfig
BR2_arm=y
BR2_arm926t=y
BR2_TOOLCHAIN_EXTERNAL=y
BR2_TOOLCHAIN_EXTERNAL_CODESOURCERY_ARM2009Q1=y
BR2_PACKAGE_DIRECTFB=y
# BR2_PACKAGE_DIRECTFB_LINUXINPUT is not set
# BR2_PACKAGE_DIRECTFB_KEYBOARD is not set
# BR2_PACKAGE_DIRECTFB_PS2MOUSE is not set
# BR2_PACKAGE_DIRECTFB_SERIALMOUSE is not set
# BR2_PACKAGE_DIRECTFB_TSLIB is not set
BR2_PACKAGE_TANGO_ICON_THEME=y
BR2_PACKAGE_I2C_TOOLS=y
BR2_PACKAGE_TI_OMAP_DAVINCI=y
BR2_PACKAGE_TI_PLATFORM_dm365=y
BR2_PACKAGE_TI_DVSDK_DM365=y
BR2_TARGET_ROOTFS_UBIFS=y
BR2_TARGET_ROOTFS_UBIFS_MAXLEBCNT=1984
BR2_TARGET_ROOTFS_UBIFS_RT_NONE=y
BR2_TARGET_ROOTFS_UBI=y
BR2_TARGET_UBOOT=y
BR2_TARGET_UBOOT_BOARDNAME="davinci_dm365leopard"
BR2_TARGET_UBOOT_CUSTOM_GIT=y
BR2_TARGET_UBOOT_CUSTOM_GIT_REPO_URL="git://github.com/Klaus-schwarzkopf/u-boot.git"
BR2_TARGET_UBOOT_CUSTOM_GIT_VERSION="release"
BR2_LINUX_KERNEL=y
BR2_LINUX_KERNEL_CUSTOM_GIT=y
BR2_LINUX_KERNEL_CUSTOM_GIT_REPO_URL="git://github.com/Klaus-schwarzkopf/linux-davinci-sensortherm.git"
BR2_LINUX_KERNEL_CUSTOM_GIT_VERSION="2.6.32"
BR2_LINUX_KERNEL_USE_CUSTOM_CONFIG=y
BR2_LINUX_KERNEL_CUSTOM_CONFIG_FILE="board/ti/dm365leopard/davinci_dm365leopard_defconfig"
```

## package/cppunit/Config.in
```kconfig
config BR2_PACKAGE_CPPUNIT
	bool "cppunit"
	help
	  CppUnit is a C++ unit testing framework. 
	  It started its life as a port of JUnit to 
	  C++ by Michael Feathers. 

	  http://cppunit.sourceforge.net
```

## package/cunit/Config.in
```kconfig
config BR2_PACKAGE_CUNIT
	bool "cunit"
	help
	  CUnit is a lightweight system for writing, administering, 
	  and running unit tests in C.  It provides C programmers a 
	  basic testing functionality with a flexible variety of 
	  user interfaces.

	  http://cunit.sourceforge.net/index.html
```

## package/exif/Config.in
```kconfig
config BR2_PACKAGE_EXIF
	bool "exif"
	help
	  Most digital cameras produce EXIF files, which are JPEG
	  files with extra tags that contain information about the
	  image.

	  http://libexif.sf.net
```

## package/tango-icon-theme/Config.in
```kconfig
config BR2_PACKAGE_TANGO_ICON_THEME
	bool "tango icon theme"
	help
	  Icons from the tango desktop project.

	  http://tango.freedesktop.org/Tango_Desktop_Project
```

## package/ti/Config.in
```kconfig
menuconfig BR2_PACKAGE_TI_OMAP_DAVINCI
	bool "TI OMAP and Davinci support"
	depends on BR2_arm
	help
    OMAP3 Support for the builtin DSP
    
if BR2_PACKAGE_TI_OMAP_DAVINCI

choice
  prompt "Processor/DSP Platform"
  default BR2_PACKAGE_TI_PLATFORM_omap3
  
  config BR2_PACKAGE_TI_PLATFORM_omap3
    bool "OMAP 3530"
  
  config BR2_PACKAGE_TI_PLATFORM_dm365
    bool "DM365"

  # TODO: Implement other platforms
  # config BR2_PACKAGE_TI_PLATFORM_l137
  #   bool "OMAP L1XX (L137)"
  # 
  # config BR2_PACKAGE_TI_PLATFORM_l138
  #   bool "OMAP L138"
  # 
  # config BR2_PACKAGE_TI_PLATFORM_dm6446
  #   bool "DM6446"
  #   
  # config BR2_PACKAGE_TI_PLATFORM_dm6467
  #   bool "DM6467"
  #
  # config BR2_PACKAGE_TI_PLATFORM_dm368
  #   bool "DM368"
  #
  # config BR2_PACKAGE_TI_PLATFORM_dm355
  #   bool "DM355"

endchoice

comment "Target components"
source "package/ti/ti-codecs-omap3/Config.in"
source "package/ti/ti-dsplink/Config.in"
source "package/ti/ti-gst-plugin/Config.in"
source "package/ti/ti-linuxutils/Config.in"
source "package/ti/ti-local-power-manager/Config.in"

comment "Staging tools"
source "package/ti/ti-biosutils/Config.in"
source "package/ti/ti-cgt6x/Config.in"
source "package/ti/ti-codec-engine/Config.in"
source "package/ti/ti-dmai/Config.in"
source "package/ti/ti-dspbios/Config.in"
source "package/ti/ti-dvsdk-dm365/Config.in"
source "package/ti/ti-edma3lld/Config.in"
source "package/ti/ti-framework-components/Config.in"
source "package/ti/ti-xdais/Config.in"
source "package/ti/ti-xdctools/Config.in"

endif
```

## package/ti/ti-biosutils/Config.in
```kconfig
config BR2_PACKAGE_TI_BIOSUTILS
	depends on BR2_PACKAGE_TI_PLATFORM_omap3
	bool "DSP/BIOS Utilities"
	help
      TI DSP/BIOS Utilities"
      http://software-dl.ti.com/dsps/dsps_public_sw/sdo_sb/targetcontent/Bios_Utils
```

## package/ti/ti-cgt6x/Config.in
```kconfig
config BR2_PACKAGE_TI_CGT6X
	depends on BR2_PACKAGE_TI_PLATFORM_omap3
	bool "DSP Code Generation Tools"
	help
	  TI DSP Code Generation Tools
	  https://www-a.ti.com/downloads/sds_support/TICodegenerationTools/download.htm
```

## package/ti/ti-codec-engine/Config.in
```kconfig
config BR2_PACKAGE_TI_CODEC_ENGINE
	bool "Codec Engine"
	depends on BR2_PACKAGE_TI_PLATFORM_omap3 
	# Could probably be used for || BR2_PACKAGE_TI_PLATFORM_dm6446
	select BR2_PACKAGE_TI_LOCAL_POWER_MANAGER
	select BR2_PACKAGE_TI_FRAMEWORK_COMPONENTS
	select BR2_PACKAGE_TI_XDAIS
	select BR2_PACKAGE_TI_XDCTOOLS
	select BR2_PACKAGE_TI_LINUXUTILS
	select BR2_PACKAGE_TI_DSPBIOS
	select BR2_PACKAGE_TI_DSPLINK
	select BR2_PACKAGE_TI_BIOSUTILS
	select BR2_PACKAGE_TI_CGT6X
	select BR2_PACKAGE_TI_EDMA3LLD
	help
	  Codec Engine for TI ARM/DSP processors
	  http://software-dl.ti.com/dsps/dsps_public_sw/sdo_sb/targetcontent/ce

config BR2_PACKAGE_TI_CODEC_ENGINE_EXAMPLES
	bool "Install Codec Engine examples on target"
	depends on BR2_PACKAGE_TI_CODEC_ENGINE
```

## package/ti/ti-codecs-omap3/Config.in
```kconfig
config BR2_PACKAGE_TI_CODECS_OMAP3
	bool "TI DSP Codecs"
	depends on BR2_PACKAGE_TI_PLATFORM_omap3
	depends on BR2_PACKAGE_TI_CODEC_ENGINE
	select BR2_PACKAGE_TI_XDCTOOLS
	select BR2_PACKAGE_TI_LINUXUTILS
	select BR2_PACKAGE_TI_LOCAL_POWER_MANAGER
	help
	  TI Codecs for the OMAP3
	  http://software-dl.ti.com/dsps/dsps_public_sw/sdo_sb/targetcontent
```

## package/ti/ti-dmai/Config.in
```kconfig
config BR2_PACKAGE_TI_DMAI
	bool "Davinci Multimedia Application Interface (DMAI)"
	depends on BR2_PACKAGE_TI_PLATFORM_omap3
	select BR2_PACKAGE_ALSA_LIB
	select BR2_PACKAGE_TI_FRAMEWORK_COMPONENTS
	select BR2_PACKAGE_TI_CODEC_ENGINE
	select BR2_PACKAGE_TI_XDCTOOLS
	select BR2_PACKAGE_TI_DSPBIOS
	select BR2_PACKAGE_TI_CGT6X
	select BR2_PACKAGE_TI_CODECS_OMAP3
	select BR2_PACKAGE_TI_LINUXUTILS
	help
      Davinci Multimedia Application Interface (DMAI) for TI ARM/DSP processors
      https://gforge.ti.com/gf/project/dmai/
```

## package/ti/ti-dspbios/Config.in
```kconfig
config BR2_PACKAGE_TI_DSPBIOS
	bool "DSP/BIOS v5 Kernel"
	depends on BR2_PACKAGE_TI_PLATFORM_omap3
	help
	  TI DSP/BIOS v5 Kernel
	  http://software-dl.ti.com/dsps/dsps_public_sw/sdo_sb/targetcontent/bios/dspbios
```

## package/ti/ti-dsplink/Config.in
```kconfig
config BR2_PACKAGE_TI_DSPLINK
	bool "DSPLink Inter-Processor Communications (IPC)"
	depends on BR2_PACKAGE_TI_PLATFORM_omap3
	# Could also be used for: BR2_PACKAGE_TI_PLATFORM_dm6467 ||  BR2_PACKAGE_TI_PLATFORM_omapl137 || BR2_PACKAGE_TI_PLATFORM_omapl138 || 
	select BR2_PACKAGE_TI_DSPBIOS
	select BR2_PACKAGE_TI_XDCTOOLS
	help
	  DSPLINK Inter-Processor Communications (IPC) for TI ARM/DSP processors
	  http://software-dl.ti.com/dsps/dsps_public_sw/DSPLink/index.html
		
	  You will need to add a startup script to load the kernel module manually.
	
```

## package/ti/ti-dvsdk-dm365/Config.in
```kconfig
config BR2_PACKAGE_TI_DVSDK_DM365
	bool "DVSDK for TI's DM365 processor"
	depends on BR2_PACKAGE_TI_PLATFORM_dm365 || BR2_PACKAGE_TI_PLATFORM_dm368
	select BR2_PACKAGE_ALSA_LIB
	help
	  TI's DVSDK
```

## package/ti/ti-edma3lld/Config.in
```kconfig
config BR2_PACKAGE_TI_EDMA3LLD
	bool "EDMA3 Low Level Driver (LLD)"
	depends on BR2_PACKAGE_TI_PLATFORM_omap3
	help
      TI EDMA3 Low Level Driver (LLD)"
      http://software-dl.ti.com/dsps/dsps_public_sw/sdo_sb/targetcontent/rtsc
```

## package/ti/ti-framework-components/Config.in
```kconfig
config BR2_PACKAGE_TI_FRAMEWORK_COMPONENTS
	bool "TI Framework Components"
	depends on BR2_PACKAGE_TI_PLATFORM_omap3	
	help
      TI Framework Components
      http://software-dl.ti.com/dsps/dsps_public_sw/sdo_sb/targetcontent/fc
```

## package/ti/ti-gst-plugin/Config.in
```kconfig
config BR2_PACKAGE_TI_GST_PLUGIN
	bool "GStreamer Plugin"
	depends on BR2_PACKAGE_TI_PLATFORM_omap3
	select BR2_PACKAGE_TI_DMAI
	select BR2_PACKAGE_TI_CODECS_OMAP3
	select BR2_PACKAGE_GSTREAMER
	select BR2_PACKAGE_GST_BASE
	help
	  GStreamer Plugin (gstreamer-ti) for TI ARM/DSP processors
	  http://gstreamer.ti.com/

config BR2_PACKAGE_TI_GST_PLUGIN
	bool "GStreamer Plugin"
	depends on BR2_PACKAGE_TI_PLATFORM_dm365
	select BR2_PACKAGE_TI_DVSDK_DM365
	select BR2_PACKAGE_GSTREAMER
	select BR2_PACKAGE_GST_BASE
	select BR2_PACKAGE_GST_PLUGINS_BASE_PLUGIN_APP
    select BR2_PACKAGE_GST_PLUGINS_BASE_PLUGIN_ADDER
	select BR2_PACKAGE_GST_PLUGINS_BASE_PLUGIN_AUDIOCONVERT
	select BR2_PACKAGE_GST_PLUGINS_BASE_PLUGIN_AUDIORATE
	select BR2_PACKAGE_GST_PLUGINS_BASE_PLUGIN_AUDIORESAMPLE
	select BR2_PACKAGE_GST_PLUGINS_BASE_PLUGIN_FFMPEGCOLORSPACE
	select BR2_PACKAGE_GST_PLUGINS_BASE_PLUGIN_TYPEFIND
	select BR2_PACKAGE_GST_PLUGINS_BASE_PLUGIN_PLAYBACK
	select BR2_PACKAGE_GST_PLUGINS_BASE_PLUGIN_VIDEOSCALE
	select BR2_PACKAGE_GST_PLUGINS_BASE_PLUGIN_VOLUME
	help
	  GStreamer Plugin (gstreamer-ti) for TI ARM/DSP processors
	  http://gstreamer.ti.com/


#TODO: Add other architectures
```

## package/ti/ti-linuxutils/Config.in
```kconfig
config BR2_PACKAGE_TI_LINUXUTILS
	bool "MFP Linux utils"
	depends on BR2_PACKAGE_TI_PLATFORM_omap3
	help
	  MFP Linux utils for TI ARM/DSP processors (a.k.a. ti-linuxutils). 
	  You will need to add a startup script to load the different kernel 
	  modules (cmemk,sdmak,etc.) manually as it is different for each platform 
	  and usage.
```

## package/ti/ti-local-power-manager/Config.in
```kconfig
config BR2_PACKAGE_TI_LOCAL_POWER_MANAGER
	bool "Local Power Manager (LPM)"
	depends on BR2_PACKAGE_TI_PLATFORM_omap3530 || BR2_PACKAGE_TI_PLATFORM_dm6446
	select BR2_PACKAGE_TI_DSPLINK
	select BR2_PACKAGE_TI_XDCTOOLS
	help
	  TI Local Power Manager (LPM)
	  http://software-dl.ti.com/dsps/dsps_public_sw/sdo_sb/targetcontent/lpm	
	  
	  Currently only make and install the lpm kernel module. 
	  And you will need to add a startup script to load the kernel module...
```

## package/ti/ti-xdais/Config.in
```kconfig
config BR2_PACKAGE_TI_XDAIS
	depends on BR2_PACKAGE_TI_PLATFORM_omap3
	bool "eXpress DSP Algorithm Interface Standard (XDAIS)"
	help
      TI eXpress DSP Algorithm Interface Standard (XDAIS) specification
      http://software-dl.ti.com/dsps/dsps_public_sw/sdo_sb/targetcontent/xdais
```

## package/ti/ti-xdctools/Config.in
```kconfig
config BR2_PACKAGE_TI_XDCTOOLS
	depends on BR2_PACKAGE_TI_PLATFORM_omap3
	bool "XDCtools"
	help
      XDCtools (RTSC - Real Time Software Components - http://rtsc.eclipse.org)
      http://software-dl.ti.com/dsps/dsps_public_sw/sdo_sb/targetcontent/rtsc
```

## package/videostream/Config.in
```kconfig
config BR2_PACKAGE_VIDEOSTREAM
	bool "videostream"
	help
	  Main program for the sensortherm mobile
	  pyrometer camera.

	  http://www.sensortherm.de

if BR2_PACKAGE_VIDEOSTREAM

config BR2_PACKAGE_VIDEOSTREAM_DEBUG
	bool "videostream debug"
	help
	  Debug videostream application.
	  Add data.img and raw.yuv.

	  http://www.sensortherm.de

endif # BR2_PACKAGE_VIDEOSTREAM
```
